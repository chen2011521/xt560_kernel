## drivers/fih/sensors/Kconfig
```kconfig
#
# Input device configuration
#

menu "Sensor devices support"
	depends on INPUT_SENSORS

menuconfig INPUT_ACCELEROMETER
        bool "Accelerometer sensor interface"
        depends on INPUT_SENSORS
        ---help---
                Say Y here if you want your ecompass to be accessible as char device
                - /dev/input/sensors/accelerometer device.

                If unsure, say N.

source "drivers/fih/sensors/accelerometer/Kconfig"

menuconfig INPUT_GEOMAGNETIC
        bool "Geomagnetic sensor interface"
        depends on INPUT_SENSORS
        ---help---
                Say Y here if you want your ecompass to be accessible as char device
                - /dev/input/sensors/geomagnetic device.

                If unsure, say N.

source "drivers/fih/sensors/geomagnetic/Kconfig"

menuconfig INPUT_GYROSCOPE
        bool "Gyroscope sensor interface"
        depends on INPUT_SENSORS
        ---help---
                Say Y here if you want your ecompass to be accessible as char device
                - /dev/input/sensors/gyroscope device.

                If unsure, say N.

source "drivers/fih/sensors/gyroscope/Kconfig"

menuconfig INPUT_LIGHT
        bool "Light interface"
        depends on INPUT_SENSORS
        ---help---
                Say Y here if you want your ecompass to be accessible as char device
                - /dev/input/sensors/light device.

                If unsure, say N.

source "drivers/fih/sensors/light/Kconfig"

menuconfig INPUT_ORIENTATION_YAMAHA
        bool "Orientation sensor interface"
        depends on INPUT_SENSORS
        ---help---
                Say Y here if you want your ecompass to be accessible as char device
                - /dev/input/sensors/orientation device.

                If unsure, say N.

source "drivers/fih/sensors/orientation/Kconfig"

menuconfig INPUT_PRESSURE
        bool "Pressure sensor interface"
        depends on INPUT_SENSORS
        ---help---
                Say Y here if you want your ecompass to be accessible as char device
                - /dev/input/sensors/pressure device.

                If unsure, say N.

source "drivers/fih/sensors/pressure/Kconfig"

menuconfig INPUT_PROXIMITY
        bool "Proximity sensor interface"
        depends on INPUT_SENSORS
        ---help---
                Say Y here if you want your ecompass to be accessible as char device
                - /dev/input/sensors/proximity device.

                If unsure, say N.

source "drivers/fih/sensors/proximity/Kconfig"

menuconfig INPUT_TEMPERATURE
        bool "Temperature sensor interface"
        depends on INPUT_SENSORS
        ---help---
                Say Y here if you want your ecompass to be accessible as char device
                - /dev/input/sensors/temperature device.

                If unsure, say N.

source "drivers/fih/sensors/temperature/Kconfig"

menuconfig INPUT_LPSENSOR
	bool "FIH LPsensor interface"
        depends on INPUT_SENSORS
	---help---
	  Say Y here if you want your gsensor to be accessible as char device
	  - /dev/input/sensors/proximitysensor device.

	  If unsure, say N.

	  To compile this driver as a module, choose Y here: the
	  module will be called psensor.

source "drivers/fih/sensors/lightproxisensor/Kconfig"
source "drivers/fih/sensors/SenseTek_proximity/Kconfig"

endmenu
```

## drivers/fih/sensors/lightproxisensor/Kconfig
```kconfig
#
# Light and Proximity drivers configuration
#

#menuconfig INPUT_LPSENSOR
#	bool "FIH Light and Proximity SENSOR devices"
#	help
#	  Say Y here, and a list of sensors input drivers will be displayed.
#	  Everything that didn't fit into the other categories is here. This option
#	  doesn't affect the kernel.
#
#	  If unsure, say Y.

if INPUT_LPSENSOR

#by WillChen 2009.05.15 FIH_Fxx
config SENSORS_LPSCM3602
	tristate "LPSCM3602 controller"
         depends on I2C&&INPUT_SENSORS
	help
		Say Y here if you want to enable LPSENSOR PSCM3602 driver.	  

config SENSORS_LTR502ALS
	tristate "LTR502ALS controller"
         depends on I2C&&INPUT_SENSORS
	help
	        Say Y here if you want to enable LPSENSOR LTR502ALS driver.

config SENSORS_YAS_CM3623
	tristate "cm3623 LPS sensors controller(For YAS)"
         depends on I2C&&INPUT_SENSORS
	help
	        Say Y here if you want to enable cm3623 LPS sensors(For YAS).
                                	  
endif
```
